## app/boards/shields/reeedox/Kconfig.shield
```kconfig
config SHIELD_REEEDOX_LEFT
    def_bool $(shields_list_contains,reeedox_left)

config SHIELD_REEEDOX_RIGHT
    def_bool $(shields_list_contains,reeedox_right)
```
