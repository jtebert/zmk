#include "reeedox.dtsi"

kscan0: kscan {
    compatible = "zmk,kscan-gpio-matrix";
    label = "KSCAN";

    diode-direction = "col2row";
    row-gpios
        = <&pro_micro_d 6 (GPIO_ACTIVE_HIGH | GPIO_PULL_DOWN)> // Row A from the schematic file
        , <&pro_micro_d 9 (GPIO_ACTIVE_HIGH | GPIO_PULL_DOWN)> // Row B from the schematic file
        , <&pro_micro_d 10 (GPIO_ACTIVE_HIGH | GPIO_PULL_DOWN)> // Row C from the schematic file
        , <&pro_micro_d 16 (GPIO_ACTIVE_HIGH | GPIO_PULL_DOWN)> // Row D from the schematic file
        , <&pro_micro_d 15 (GPIO_ACTIVE_HIGH | GPIO_PULL_DOWN)> // Row E from the schematic file
        ;

    col-gpios
        = <&pro_micro_d 5 GPIO_ACTIVE_HIGH> // col 0
        , <&pro_micro_d 4 GPIO_ACTIVE_HIGH> // col 1
        , <&pro_micro_d 3 GPIO_ACTIVE_HIGH> // col 2
        , <&pro_micro_d 2 GPIO_ACTIVE_HIGH> // col 3
        , <&pro_micro_d 1 GPIO_ACTIVE_HIGH> // col 4
        , <&pro_micro_d 0 GPIO_ACTIVE_HIGH> // col 5
        , <&pro_micro_d 8 GPIO_ACTIVE_HIGH> // col 6
        , <&pro_micro_d 14 GPIO_ACTIVE_HIGH> // col 7
        ;
};
